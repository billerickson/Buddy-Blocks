## firmware/esp32-p4/main/Kconfig.projbuild
```kconfig
menu "Buddy Blocks hardware proof"

choice BUDDY_ROTATION_PATH
    prompt "Landscape rotation candidate"
    default BUDDY_ROTATION_PATH_BSP

    config BUDDY_ROTATION_PATH_BSP
        bool "Waveshare BSP adapter rotation"
        help
            Use BSP 1.0.1 with ESP_LV_ADAPTER_ROTATE_90. This is the first
            physical candidate and keeps the BSP's PPA setting disabled.

    config BUDDY_ROTATION_PATH_CPU
        bool "Deferred CPU full-frame rotation"
        help
            Render two full 800x480 RGB565 buffers in PSRAM and rotate into a
            separate 480x800 scanout buffer on a dedicated task.

    config BUDDY_ROTATION_PATH_PPA
        bool "Direct esp_lv_adapter PPA rotation"
        help
            Register the BSP panel directly with esp_lv_adapter and explicitly
            enable the ESP32-P4 PPA rotation path.
endchoice

config BUDDY_CPU_ROTATE_CLOCKWISE
    bool "Rotate the CPU candidate clockwise"
    default y
    depends on BUDDY_ROTATION_PATH_CPU

config BUDDY_TOUCH_SWAP_XY
    bool "Swap GT911 X/Y"
    default y

config BUDDY_TOUCH_MIRROR_X
    bool "Mirror GT911 X"
    default y

config BUDDY_TOUCH_MIRROR_Y
    bool "Mirror GT911 Y"
    default n

config BUDDY_WIFI_SSID
    string "Wi-Fi SSID for the Milestone 0 proof"
    default ""
    help
        Stored only in the ignored generated sdkconfig. Never add a real SSID
        to sdkconfig.defaults or another tracked file.

config BUDDY_WIFI_PASSWORD
    string "Wi-Fi password for the Milestone 0 proof"
    default ""
    help
        Stored only in the ignored generated sdkconfig and never logged.

config BUDDY_WIFI_MAX_RETRIES
    int "Maximum initial Wi-Fi retries"
    range 0 20
    default 5

config BUDDY_API_BASE_URL
    string "Buddy Blocks HTTPS API origin"
    default "https://buddyblocks.net"
    help
        Public origin only; never include credentials or a trailing slash.

config BUDDY_HARDWARE_REVISION
    string "Hardware revision API profile"
    default "rev3"
    help
        Must be rev3 or rev1_3 and must agree with the silicon build overlay.

config BUDDY_FIRMWARE_VERSION
    string "Semantic firmware version"
    default "0.1.0"
    help
        Embedded in device requests and diagnostics. Release packaging supplies
        this from the requested package version; ordinary builds use 0.1.0.

endmenu
```

## firmware/esp32-p4/sdkconfig.defaults
```kconfig
CONFIG_IDF_TARGET="esp32p4"
CONFIG_APP_REPRODUCIBLE_BUILD=y
CONFIG_BOOTLOADER_LOG_LEVEL_WARN=y
CONFIG_BOOTLOADER_LOG_LEVEL=2
CONFIG_BOOTLOADER_APP_ROLLBACK_ENABLE=y
CONFIG_ESPTOOLPY_FLASHMODE_QIO=y
CONFIG_ESPTOOLPY_FLASHSIZE_32MB=y
CONFIG_ESPTOOLPY_FLASHSIZE="32MB"
CONFIG_PARTITION_TABLE_CUSTOM=y
CONFIG_PARTITION_TABLE_CUSTOM_FILENAME="partitions.csv"
CONFIG_PARTITION_TABLE_OFFSET=0x10000
CONFIG_COMPILER_OPTIMIZATION_PERF=y
CONFIG_COMPILER_CXX_EXCEPTIONS=n
CONFIG_COMPILER_CXX_RTTI=n
CONFIG_SPIRAM=y
CONFIG_SPIRAM_XIP_FROM_PSRAM=y
CONFIG_CACHE_L2_CACHE_256KB=y
CONFIG_CACHE_L2_CACHE_LINE_128B=y
CONFIG_ESP_MAIN_TASK_STACK_SIZE=12288
CONFIG_FREERTOS_HZ=1000
CONFIG_FREERTOS_VTASKLIST_INCLUDE_COREID=y
CONFIG_FREERTOS_GENERATE_RUN_TIME_STATS=y
CONFIG_LV_OS_FREERTOS=y
CONFIG_LV_USE_CLIB_MALLOC=y
CONFIG_LV_USE_CLIB_STRING=y
CONFIG_LV_USE_CLIB_SPRINTF=y
CONFIG_LV_DEF_REFR_PERIOD=15
CONFIG_LV_OBJ_STYLE_CACHE=y
CONFIG_LV_DRAW_SW_DRAW_UNIT_CNT=2
CONFIG_LV_FONT_MONTSERRAT_16=y
CONFIG_LV_FONT_MONTSERRAT_20=y
CONFIG_LV_FONT_MONTSERRAT_24=y
CONFIG_LV_FONT_MONTSERRAT_28=y
CONFIG_LV_USE_FONT_COMPRESSED=y
CONFIG_LV_TXT_BREAK_CHARS=" ,.;:-_"
CONFIG_LV_BUILD_EXAMPLES=n
CONFIG_LV_BUILD_DEMOS=n
CONFIG_LV_USE_QRCODE=y
CONFIG_IDF_EXPERIMENTAL_FEATURES=y
CONFIG_SPI_FLASH_SUPPORT_GD_CHIP=y
CONFIG_ESP_WIFI_SOFTAP_SUPPORT=n
```
